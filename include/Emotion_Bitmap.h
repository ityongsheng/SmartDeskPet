#ifndef EMOTION_BITMAP_H
#define EMOTION_BITMAP_H

#include <Arduino.h>
#include <U8g2lib.h>

/**
 * 表情库 - 像素级表情绘制
 * 使用U8g2的drawBitmap()实现像素级控制
 * 支持自定义表情和动画序列
 */

// ==================== 表情数据结构 ====================

/**
 * 单帧表情数据
 */
struct EmotionFrame {
    const unsigned char* bitmap;  // 位图数据指针
    uint8_t width;                // 位图宽度（像素）
    uint8_t height;               // 位图高度（像素）
    uint16_t duration;            // 显示时长（毫秒）
};

/**
 * 表情序列（支持动画）
 */
struct EmotionSequence {
    const EmotionFrame* frames;
    uint8_t frameCount;           // 总帧数
};

// ==================== 表情位图定义 ====================

// HAPPY 😊 (32x32 像素)
static const unsigned char BITMAP_HAPPY[] PROGMEM = {
    // 圆脸框
    0x00, 0x00, 0x1C, 0x00,
    0x00, 0x00, 0x3E, 0x00,
    0x00, 0x00, 0x7F, 0x00,
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    0x00, 0x00, 0x1C, 0x00,
    // 左眼和眉毛
    0x00, 0x00, 0x00, 0x00,
    0x00, 0x00, 0x00, 0x00,
    0x00, 0x18, 0x00, 0x00,
    0x00, 0x3C, 0x00, 0x00,
    0x00, 0x3C, 0x00, 0x00,
    0x00, 0x18, 0x00, 0x00,
    // 右眼和眉毛
    0x00, 0x00, 0x18, 0x00,
    0x00, 0x00, 0x3C, 0x00,
    0x00, 0x00, 0x3C, 0x00,
    0x00, 0x00, 0x18, 0x00,
    // 开心的嘴 (弧形)
    0x00, 0x00, 0x00, 0x00,
    0x00, 0x07, 0xE0, 0x00,
    0x00, 0x0F, 0xF0, 0x00,
    0x00, 0x1F, 0xF8, 0x00,
    0x00, 0x1F, 0xF8, 0x00,
    0x00, 0x0F, 0xF0, 0x00,
    0x00, 0x07, 0xE0, 0x00,
};

// SAD 😢 (32x32 像素)
static const unsigned char BITMAP_SAD[] PROGMEM = {
    // 圆脸框 (与HAPPY相同)
    0x00, 0x00, 0x1C, 0x00,
    0x00, 0x00, 0x3E, 0x00,
    0x00, 0x00, 0x7F, 0x00,
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    0x00, 0x00, 0x1C, 0x00,
    // 伤心的眼睛 (泪滴)
    0x00, 0x18, 0x00, 0x18,
    0x00, 0x3C, 0x00, 0x3C,
    0x00, 0x3C, 0x00, 0x3C,
    0x00, 0x18, 0x00, 0x18,
    // 伤心的嘴 (倒弧形)
    0x00, 0x00, 0x00, 0x00,
    0x00, 0x07, 0xE0, 0x00,
    0x00, 0x0F, 0xF0, 0x00,
    0x00, 0x1F, 0xF8, 0x00,
    0x00, 0x1F, 0xF8, 0x00,
    0x00, 0x0F, 0xF0, 0x00,
    0x00, 0x07, 0xE0, 0x00,
};

// ANGRY 😠 (32x32 像素)
static const unsigned char BITMAP_ANGRY[] PROGMEM = {
    // 圆脸框
    0x00, 0x00, 0x1C, 0x00,
    0x00, 0x00, 0x3E, 0x00,
    0x00, 0x00, 0x7F, 0x00,
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    0x00, 0x00, 0x1C, 0x00,
    // 生气的眉毛和眼睛
    0x0F, 0x00, 0x00, 0xF0,
    0x1F, 0x80, 0x01, 0xF8,
    0x0F, 0x80, 0x01, 0xF0,
    0x07, 0x00, 0x00, 0xE0,
    // 生气的嘴 (直线)
    0x00, 0x00, 0x00, 0x00,
    0x00, 0x0F, 0xF0, 0x00,
    0x00, 0x0F, 0xF0, 0x00,
    0x00, 0x0F, 0xF0, 0x00,
    0x00, 0x0F, 0xF0, 0x00,
    0x00, 0x0F, 0xF0, 0x00,
    0x00, 0x07, 0xE0, 0x00,
};

// HOT_WARNING 🔥 (表示太热)
static const unsigned char BITMAP_HOT[] PROGMEM = {
    // 红色的脸
    0x00, 0x00, 0x1C, 0x00,
    0x00, 0x00, 0x3E, 0x00,
    0x00, 0x00, 0x7F, 0x00,
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    0x00, 0x00, 0x1C, 0x00,
    // 流汗的眼睛
    0x00, 0x18, 0x00, 0x18,
    0x00, 0x3C, 0x00, 0x3C,
    0x00, 0x3C, 0x00, 0x3C,
    0x00, 0x18, 0x00, 0x18,
    // 流汗的嘴 (张口)
    0x00, 0x00, 0x00, 0x00,
    0x00, 0x07, 0xE0, 0x00,
    0x00, 0x0F, 0xF0, 0x00,
    0x00, 0x1F, 0xF8, 0x00,
    0x00, 0x1F, 0xF8, 0x00,
    0x00, 0x0F, 0xF0, 0x00,
    0x00, 0x07, 0xE0, 0x00,
};

// HEART 💗 (爱心)
static const unsigned char BITMAP_HEART[] PROGMEM = {
    0x00, 0x00, 0x00, 0x00,
    0x00, 0x06, 0x60, 0x00,
    0x00, 0x0F, 0xF0, 0x00,
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    0x00, 0x00, 0x00, 0x00,
};

// SUN ☀️ (太阳 - 天气晴朗)
static const unsigned char BITMAP_SUN[] PROGMEM = {
    0x00, 0x03, 0xC0, 0x00,
    0x00, 0x07, 0xE0, 0x00,
    0x00, 0x0F, 0xF0, 0x00,
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    0xF0, 0x00, 0x00, 0x0F,
};

// RAIN 🌧️ (下雨)
static const unsigned char BITMAP_RAIN[] PROGMEM = {
    0x00, 0x3F, 0xFC, 0x00,
    0x00, 0x7F, 0xFE, 0x00,
    0x00, 0xFF, 0xFF, 0x00,
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    0x3C, 0x3C, 0x3C, 0x3C,
};

// CLOUD ☁️ (阴天)
static const unsigned char BITMAP_CLOUD[] PROGMEM = {
    0x00, 0x01, 0xF8, 0x00,
    0x00, 0x03, 0xFC, 0x00,
    0x00, 0x07, 0xFE, 0x00,
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    0x00, 0x07, 0xFE, 0x00,
};

// ==================== 表情管理类 ====================

class EmotionBitmapLibrary {
private:
    U8G2_SSD1315_128X64_1_HW_I2C* display;
    
public:
    EmotionBitmapLibrary();
    
    /**
     * 初始化表情库
     */
    void begin(U8G2_SSD1315_128X64_1_HW_I2C* disp) {
        display = disp;
    }
    
    /**
     * 绘制表情位图
     * @param bitmap 位图数据
     * @param x X坐标
     * @param y Y坐标
     * @param w 宽度
     * @param h 高度
     */
    void drawEmotionBitmap(const unsigned char* bitmap, 
                          uint8_t x, uint8_t y, 
                          uint8_t w, uint8_t h) {
        if (display) {
            display->drawBitmap(x, y, (const uint8_t*)bitmap, w, h, 1);
            display->sendBuffer();
        }
    }
    
    /**
     * 绘制天气图标
     */
    void drawWeatherIcon(const char* weather, uint8_t x, uint8_t y) {
        if (strstr(weather, "晴") || strstr(weather, "sunny")) {
            drawEmotionBitmap(BITMAP_SUN, x, y, 32, 16);
        } 
        else if (strstr(weather, "雨") || strstr(weather, "rain")) {
            drawEmotionBitmap(BITMAP_RAIN, x, y, 32, 16);
        }
        else if (strstr(weather, "云") || strstr(weather, "cloud")) {
            drawEmotionBitmap(BITMAP_CLOUD, x, y, 32, 16);
        }
    }
    
    /**
     * 绘制表情（带颜色反转效果）
     */
    void drawEmotionAnimated(const unsigned char* bitmap, 
                            uint8_t x, uint8_t y, 
                            uint8_t w, uint8_t h,
                            bool inverse = false) {
        display->clearBuffer();
        if (inverse) {
            display->setDrawColor(0);  // 反色
        }
        drawEmotionBitmap(bitmap, x, y, w, h);
        if (inverse) {
            display->setDrawColor(1);  // 恢复
        }
    }
};

#endif
